## build/conf/bblayers.conf
```bitbake
# POKY_BBLAYERS_CONF_VERSION is increased each time build/conf/bblayers.conf
# changes incompatibly
POKY_BBLAYERS_CONF_VERSION = "2"

BBFILES ?= ""

BBLAYERS ?= " \
  ${HOME}/jetson-nano/sources/poky/meta \
  ${HOME}/jetson-nano/sources/poky/meta-poky \
  ${HOME}/jetson-nano/sources/poky/meta-yocto-bsp \
  ${HOME}/jetson-nano/sources/meta-tegra \
  ${HOME}/jetson-nano/sources/meta-openembedded/meta-oe \
  ${HOME}/jetson-nano/sources/meta-openembedded/meta-multimedia \
  ${HOME}/jetson-nano/sources/meta-openembedded/meta-networking \
  ${HOME}/jetson-nano/sources/meta-openembedded/meta-python \
"
```

## build/conf/local.conf
```bitbake
MACHINE ??= "jetson-nano"
DISTRO ?= "poky"
PACKAGE_CLASSES ?= "package_rpm package_deb"
EXTRA_IMAGE_FEATURES ?= "debug-tweaks package-management"
USER_CLASSES ?= "buildstats image-mklibs image-prelink"
PATCHRESOLVE = "noop"
BB_DISKMON_DIRS ??= "\
    STOPTASKS,${TMPDIR},1G,100K \
    STOPTASKS,${DL_DIR},1G,100K \
    STOPTASKS,${SSTATE_DIR},1G,100K \
    STOPTASKS,/tmp,100M,100K \
    ABORT,${TMPDIR},100M,1K \
    ABORT,${DL_DIR},100M,1K \
    ABORT,${SSTATE_DIR},100M,1K \
    ABORT,/tmp,10M,1K"
PACKAGECONFIG_append_pn-qemu-system-native = " sdl"
PACKAGECONFIG_append_pn-nativesdk-qemu = " sdl"

# This really saves a lot of disk space!
IMAGE_CLASSES += "image_types_tegra"               
TEGRAFLASH_SDCARD_SIZE ?= "4G"
IMAGE_FSTYPES = "tegraflash"
CUDA_VERSION="10.0"
NVIDIA_DEVNET_MIRROR = "file:///home/leon/Downloads/nvidia/sdkm_downloads"
INHERIT += "rm_work"

DISTRO_FEATURES_append = " systemd wayland pam x11"
VIRTUAL-RUNTIME_init_manager = "systemd"
DISTRO_FEATURES_BACKFILL_CONSIDERED = "sysvinit"
VIRTUAL-RUNTIME_initscripts = ""
EXTRA_IMAGE_FEATURES += " ssh-server-dropbear splash package-management x11-base hwcodecs"
```
